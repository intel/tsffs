## examples/tests/riscv-64/test-kernel-modules/package/kernel-modules/test-mod/Config.in
```kconfig
config BR2_PACKAGE_TEST_MOD
    bool "test-mod"
    depends on BR2_LINUX_KERNEL
    help
        Test kernel module for TSFFS fuzzing
```

## examples/tutorials/risc-v-kernel/src/tutorial-kernel-modules/Config.in
```kconfig
source "$BR2_EXTERNAL_TUTORIAL_KERNEL_MODULES_PATH/package/kernel-modules/Config.in"
```

## examples/tutorials/risc-v-kernel/src/tutorial-kernel-modules/package/kernel-modules/Config.in
```kconfig
menu "Kernel Modules"
    source "$BR2_EXTERNAL_TUTORIAL_KERNEL_MODULES_PATH/package/kernel-modules/tutorial-mod/Config.in"
endmenu
```

## examples/tutorials/risc-v-kernel/src/tutorial-kernel-modules/package/kernel-modules/tutorial-mod/Config.in
```kconfig
config BR2_PACKAGE_TUTORIAL_MOD
    bool "tutorial-mod"
    depends on BR2_LINUX_KERNEL
    help
        Tutorial kernel module for TSFFS fuzzing
```

## modules/tsffs/tests/targets/minimal-riscv-64/test-kernel-modules/package/kernel-modules/Config.in
```kconfig
menu "Kernel Modules"
    source "$BR2_EXTERNAL_TEST_KERNEL_MODULES_PATH/package/kernel-modules/test-mod/Config.in"
endmenu
```
